## system/u-boot/configs/allwinner_f1c100s_generic_defconfig
```kconfig
CONFIG_ARM=y
CONFIG_ARCH_SUNXI=y
CONFIG_MACH_SUNIV=y
CONFIG_DEFAULT_DEVICE_TREE="suniv-f1c100s-generic"

CONFIG_SPL=y
CONFIG_SPL_SPI_SUNXI=y
CONFIG_MMC_SUNXI_SLOT_EXTRA=1

CONFIG_VIDEO_LCD_MODE="x:480,y:272,depth:18,pclk_khz:10000,le:42,ri:8,up:11,lo:4,hs:1,vs:1,sync:3,vmode:0"
CONFIG_VIDEO_LCD_BL_PWM="PE6"
CONFIG_VIDEO_LCD_BL_PWM_ACTIVE_LOW=n

CONFIG_BOOTDELAY=5
CONFIG_USE_BOOTARGS=y
CONFIG_BOOTARGS="console=ttyS0,115200 panic=5 rootwait root=/dev/mmcblk0p2 earlyprintk rw"
CONFIG_USE_BOOTCOMMAND=y
CONFIG_BOOTCOMMAND="load mmc 0:1 0x80008000 zImage;load mmc 0:1 0x80c08000 suniv-f1c100s-licheepi-nano.dtb;bootz 0x80008000 - 0x80c08000;"

CONFIG_SYS_TEXT_BASE=0x81700000

CONFIG_DRAM_CLK=156
CONFIG_DRAM_ZQ=0

CONFIG_NET=n

CONFIG_PHY=y
CONFIG_PHY_SUN4I_USB=y

CONFIG_USB_MUSB_SUNXI=y
CONFIG_USB_MUSB_GADGET=y
CONFIG_USB_MUSB_PIO_ONLY=y
CONFIG_USB_MUSB_DISABLE_BULK_COMBINE_SPLIT=y
CONFIG_USB_GADGET_VBUS_DRAW=250

CONFIG_USB_STORAGE=y

CONFIG_CMD_USB_MASS_STORAGE=y

CONFIG_CMD_FASTBOOT=y
CONFIG_FASTBOOT_FLASH_MMC=y
CONFIG_FASTBOOT_FLASH_MMC_DEV=1
CONFIG_FASTBOOT_CMD_OEM_FORMAT=y

CONFIG_ENV_SIZE=0x8000
CONFIG_ENV_OFFSET=0xf8000
CONFIG_ENV_SECT_SIZE=0x1000

CONFIG_CMD_SF=y
CONFIG_CMD_SPI=y
CONFIG_ENV_IS_IN_SPI_FLASH=y
CONFIG_DM_SPI_FLASH=y
CONFIG_SPI_FLASH=y
CONFIG_SPI_FLASH_BAR=y
CONFIG_SPI_FLASH_GIGADEVICE=y
CONFIG_SPI_FLASH_MACRONIX=y
CONFIG_SPI_FLASH_WINBOND=y

# CONFIG_SPL_DM_SERIAL is not set

CONFIG_SPI=y
CONFIG_DM_SPI=y
CONFIG_SPI_SUNXI=y
```
